## iris/firmware/main/Kconfig.projbuild
```kconfig
menu "Iris"

config IRIS_WIFI_SSID
    string "Wi-Fi SSID"
    default ""
    help
        The 2.4 GHz Wi-Fi network used for time and weather updates.
        Leave blank to run the clock in offline mode.

config IRIS_WIFI_PASSWORD
    string "Wi-Fi password"
    default ""
    help
        Wi-Fi password. It is stored in sdkconfig, so keep that file private.

config IRIS_LOCATION_NAME
    string "Location label"
    default "Home"

config IRIS_LATITUDE
    string "Latitude"
    default "37.7749"
    help
        Decimal latitude used for the Open-Meteo request.

config IRIS_LONGITUDE
    string "Longitude"
    default "-122.4194"
    help
        Decimal longitude used for the Open-Meteo request.

config IRIS_TIMEZONE
    string "IANA timezone"
    default "America/Los_Angeles"
    help
        POSIX TZ database name used to render local time.

config IRIS_BRIGHTNESS
    int "Display brightness"
    range 5 100
    default 65

endmenu
```

## iris/firmware/sdkconfig.defaults
```kconfig
# Waveshare ESP32-S3-Touch-AMOLED-1.75C defaults
CONFIG_ESPTOOLPY_FLASHSIZE_32MB=y
CONFIG_PARTITION_TABLE_CUSTOM=y
CONFIG_PARTITION_TABLE_CUSTOM_FILENAME="partitions.csv"
CONFIG_ESP_DEFAULT_CPU_FREQ_MHZ_240=y
CONFIG_SPIRAM=y
CONFIG_SPIRAM_MODE_OCT=y
CONFIG_SPIRAM_SPEED_80M=y
CONFIG_SPIRAM_FETCH_INSTRUCTIONS=y
CONFIG_SPIRAM_RODATA=y
CONFIG_ESP32S3_DATA_CACHE_LINE_64B=y
CONFIG_COMPILER_OPTIMIZATION_PERF=y

# LVGL 9 and the board adapter
CONFIG_FREERTOS_HZ=1000
CONFIG_LV_OS_FREERTOS=y
CONFIG_LV_DEF_REFR_PERIOD=15
CONFIG_LV_FONT_MONTSERRAT_16=y
CONFIG_LV_FONT_MONTSERRAT_24=y
CONFIG_LV_FONT_MONTSERRAT_48=y
CONFIG_LV_USE_CLIB_MALLOC=y
CONFIG_LV_USE_CLIB_STRING=y
CONFIG_LV_USE_CLIB_SPRINTF=y

# HTTPS certificate validation for Open-Meteo
CONFIG_MBEDTLS_CERTIFICATE_BUNDLE=y
CONFIG_MBEDTLS_CERTIFICATE_BUNDLE_DEFAULT_CMN=y

# BSP defaults
CONFIG_BSP_I2C_FAST_MODE=y
```
